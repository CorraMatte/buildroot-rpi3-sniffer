## configs/raspberrypi3_defconfig
```kconfig
BR2_arm=y
BR2_cortex_a7=y
BR2_ARM_FPU_NEON_VFPV4=y
BR2_CCACHE=y
BR2_OPTIMIZE_3=y
BR2_TOOLCHAIN_BUILDROOT_LOCALE=y
BR2_TOOLCHAIN_BUILDROOT_CXX=y
BR2_GCC_ENABLE_OPENMP=y
BR2_TARGET_GENERIC_ISSUE="Welcome to Sniffer CANBUS"
# BR2_TARGET_ENABLE_ROOT_LOGIN is not set
# BR2_TARGET_GENERIC_GETTY is not set
BR2_ROOTFS_POST_BUILD_SCRIPT="board/raspberrypi3/post-build.sh"
BR2_ROOTFS_POST_IMAGE_SCRIPT="board/raspberrypi3/post-image.sh"
BR2_ROOTFS_POST_SCRIPT_ARGS="--add-pi3-miniuart-bt-overlay"
BR2_LINUX_KERNEL=y
BR2_LINUX_KERNEL_CUSTOM_GIT=y
BR2_LINUX_KERNEL_CUSTOM_REPO_URL="https://github.com/raspberrypi/linux.git"
BR2_LINUX_KERNEL_CUSTOM_REPO_VERSION="84a1781639429747b894f5121476b514a6a20651"
BR2_LINUX_KERNEL_USE_CUSTOM_CONFIG=y
BR2_LINUX_KERNEL_CUSTOM_CONFIG_FILE="configs/linux_defconfigs"
BR2_LINUX_KERNEL_LZ4=y
BR2_LINUX_KERNEL_DTS_SUPPORT=y
BR2_LINUX_KERNEL_INTREE_DTS_NAME="bcm2710-rpi-3-b"
BR2_PACKAGE_BUSYBOX_SHOW_OTHERS=y
BR2_PACKAGE_ALSA_UTILS=y
BR2_PACKAGE_ALSA_UTILS_APLAY=y
BR2_PACKAGE_V4L2GRAB=y
BR2_PACKAGE_GZIP=y
BR2_PACKAGE_UNZIP=y
BR2_PACKAGE_ZIP=y
BR2_PACKAGE_DSTAT=y
BR2_PACKAGE_MEMSTAT=y
BR2_PACKAGE_CMAKE_CTEST=y
BR2_PACKAGE_MAKE=y
BR2_PACKAGE_EFL=y
BR2_PACKAGE_EFL_OPENGL_NONE=y
BR2_PACKAGE_XKEYBOARD_CONFIG=y
BR2_PACKAGE_RPI_FIRMWARE=y
BR2_PACKAGE_RPI_FIRMWARE_X=y
BR2_PACKAGE_GPSD=y
BR2_PACKAGE_GPSD_DEVICES="/dev/ttyAMA0"
BR2_PACKAGE_GPSD_PPS=y
BR2_PACKAGE_GPSD_GPSCLOCK=y
BR2_PACKAGE_GPSD_MTK3301=y
BR2_PACKAGE_GPSD_NMEA2000=y
BR2_PACKAGE_GPSD_RTCM104V2=y
BR2_PACKAGE_GPSD_RTCM104V3=y
BR2_PACKAGE_GPSD_UBX=y
BR2_PACKAGE_KBD=y
BR2_PACKAGE_LM_SENSORS=y
BR2_PACKAGE_RPI_USERLAND=y
BR2_PACKAGE_PYTHON_PY_PYC=y
BR2_PACKAGE_PYTHON_CURSES=y
BR2_PACKAGE_PYTHON_SSL=y
BR2_PACKAGE_PYTHON_BITSTRING=y
BR2_PACKAGE_PYTHON_CAN=y
BR2_PACKAGE_PYTHON_GPS3=y
BR2_PACKAGE_PYTHON_NUMPY=y
BR2_PACKAGE_PYTHON_SETUPTOOLS=y
BR2_PACKAGE_PYTHON_SIX=y
BR2_PACKAGE_SQLITE=y
BR2_PACKAGE_OPENCV=y
BR2_PACKAGE_BCM2835=y
BR2_PACKAGE_LIBV4L_UTILS=y
BR2_PACKAGE_LIBXKBCOMMON=y
BR2_PACKAGE_MTDEV=y
BR2_PACKAGE_LIBSOCKETCAN=y
BR2_PACKAGE_LIBEVDEV=y
BR2_PACKAGE_LIBPTHREAD_STUBS=y
BR2_PACKAGE_COLLECTD=y
BR2_PACKAGE_COLLECTD_CPUSLEEP=y
BR2_PACKAGE_COLLECTD_DF=y
BR2_PACKAGE_COLLECTD_PING=y
BR2_PACKAGE_XUTIL_UTIL_MACROS=y
BR2_PACKAGE_CAN_UTILS=y
BR2_PACKAGE_IPROUTE2=y
BR2_PACKAGE_OPKG=y
BR2_PACKAGE_OPKG_GPG_SIGN=y
BR2_PACKAGE_RPM=y
BR2_PACKAGE_BASH=y
BR2_PACKAGE_TMUX=y
BR2_PACKAGE_ATOP=y
BR2_PACKAGE_BOOTUTILS=y
BR2_PACKAGE_COREUTILS=y
BR2_PACKAGE_HTOP=y
BR2_PACKAGE_KMOD=y
BR2_PACKAGE_UTIL_LINUX_HWCLOCK=y
BR2_PACKAGE_UTIL_LINUX_KILL=y
BR2_PACKAGE_UTIL_LINUX_MOUNT=y
BR2_TARGET_ROOTFS_EXT2=y
BR2_TARGET_ROOTFS_EXT2_4=y
BR2_TARGET_ROOTFS_EXT2_GZIP=y
# BR2_TARGET_ROOTFS_TAR is not set
BR2_PACKAGE_HOST_DOSFSTOOLS=y
BR2_PACKAGE_HOST_GENIMAGE=y
BR2_PACKAGE_HOST_MTOOLS=y
```

## package/pcan-driver/Config.in
```kconfig
config BR2_PACKAGE_PCAN_DRIVER

	bool "pcan-driver"

	help
		PCAN driver from PEAK
		http://www.peak-system.com/fileadmin/media/linux/index.htm
```

## package/python-gps3/Config.in
```kconfig
config BR2_PACKAGE_PYTHON_GPS3

	bool "python-gps3"
	depends on BR2_PACKAGE_PYTHON

	help
		Python GPS3 module  
		https://github.com/wadda/gps3
```
